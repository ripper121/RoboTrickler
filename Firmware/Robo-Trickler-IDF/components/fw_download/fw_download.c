#include <inttypes.h>
#include <stdint.h>
#include <stdio.h>
#include <stdlib.h>
#include <string.h>

#include "fw_download.h"

#include "cJSON.h"
#include "build_info.h"
#include "esp_check.h"
#include "esp_err.h"
#include "esp_http_client.h"
#include "esp_log.h"

static const char *TAG = "fw_download";

#define JSON_BUF_SIZE 512
#define DL_CHUNK_SIZE 4096
#define FW_SAVE_PATH "/sdcard/firmware.bin"

/* RT_BUILD_EPOCH is generated by the main app build and shared here. */
#ifndef RT_BUILD_EPOCH
#define RT_BUILD_EPOCH 0
#endif
#define FW_BUILD_EPOCH RT_BUILD_EPOCH

/**
 * HTTP GET url, read the full response body into buf (null-terminated).
 * buf_size must include room for the null terminator.
 */
static esp_err_t fetch_json(const char *url, char *buf, int buf_size)
{
    esp_http_client_config_t http_cfg = {
        .url = url,
        .timeout_ms = 10000,
    };

    esp_http_client_handle_t client = esp_http_client_init(&http_cfg);
    if (!client) {
        return ESP_ERR_NO_MEM;
    }

    esp_err_t err = esp_http_client_open(client, 0);
    if (err != ESP_OK) {
        ESP_LOGE(TAG, "HTTP open failed: %s", esp_err_to_name(err));
        esp_http_client_cleanup(client);
        return err;
    }

    esp_http_client_fetch_headers(client);

    int total = 0;
    int rd = 0;
    while (total < buf_size - 1) {
        rd = esp_http_client_read(client, buf + total, buf_size - 1 - total);
        if (rd <= 0) {
            break;
        }
        total += rd;
    }
    buf[total] = '\0';

    int status = esp_http_client_get_status_code(client);
    esp_http_client_close(client);
    esp_http_client_cleanup(client);

    if (rd < 0) {
        ESP_LOGE(TAG, "HTTP read error for %s", url);
        return ESP_FAIL;
    }
    if (status != 200) {
        ESP_LOGE(TAG, "HTTP %d for %s", status, url);
        return ESP_FAIL;
    }
    return ESP_OK;
}

/** HTTP GET url, stream response body to FW_SAVE_PATH on the SD card. */
static esp_err_t download_firmware(const char *url)
{
    char *chunk = malloc(DL_CHUNK_SIZE);
    if (!chunk) {
        return ESP_ERR_NO_MEM;
    }

    esp_http_client_config_t http_cfg = {
        .url = url,
        .timeout_ms = 60000,
        .buffer_size = DL_CHUNK_SIZE,
    };

    esp_http_client_handle_t client = esp_http_client_init(&http_cfg);
    if (!client) {
        free(chunk);
        return ESP_ERR_NO_MEM;
    }

    esp_err_t err = esp_http_client_open(client, 0);
    if (err != ESP_OK) {
        ESP_LOGE(TAG, "HTTP open failed: %s", esp_err_to_name(err));
        esp_http_client_cleanup(client);
        free(chunk);
        return err;
    }

    esp_http_client_fetch_headers(client);

    FILE *f = fopen(FW_SAVE_PATH, "wb");
    if (!f) {
        ESP_LOGE(TAG, "Cannot open %s for writing", FW_SAVE_PATH);
        esp_http_client_close(client);
        esp_http_client_cleanup(client);
        free(chunk);
        return ESP_FAIL;
    }

    int total = 0;
    int rd = 0;
    while ((rd = esp_http_client_read(client, chunk, DL_CHUNK_SIZE)) > 0) {
        if (fwrite(chunk, 1, rd, f) != (size_t)rd) {
            ESP_LOGE(TAG, "File write error at offset %d", total);
            fclose(f);
            esp_http_client_close(client);
            esp_http_client_cleanup(client);
            free(chunk);
            return ESP_FAIL;
        }
        total += rd;
    }

    fclose(f);
    int status = esp_http_client_get_status_code(client);
    esp_http_client_close(client);
    esp_http_client_cleanup(client);
    free(chunk);

    if (rd < 0 || status != 200) {
        ESP_LOGE(TAG, "Download failed: HTTP %d, last read %d", status, rd);
        return ESP_FAIL;
    }

    ESP_LOGI(TAG, "Saved %d bytes to %s", total, FW_SAVE_PATH);
    return ESP_OK;
}

esp_err_t fw_download_probe(const app_config_t *cfg, fw_download_info_t *out_info)
{
    if (cfg == NULL || out_info == NULL || cfg->fw_update.url[0] == '\0') {
        return ESP_ERR_INVALID_ARG;
    }

    memset(out_info, 0, sizeof(*out_info));
    out_info->local_build_epoch = (uint32_t)FW_BUILD_EPOCH;
    snprintf(out_info->file, sizeof(out_info->file), "firmware.bin");

    char json_url[148];
    snprintf(json_url, sizeof(json_url), "%s/firmware.json", cfg->fw_update.url);

    static char json_buf[JSON_BUF_SIZE];
    ESP_RETURN_ON_ERROR(fetch_json(json_url, json_buf, sizeof(json_buf)),
                        TAG,
                        "fetch firmware.json failed");

    cJSON *root = cJSON_Parse(json_buf);
    if (!root) {
        ESP_LOGE(TAG, "JSON parse failed");
        return ESP_FAIL;
    }

    const cJSON *epoch_item = cJSON_GetObjectItem(root, "build_epoch");
    if (!cJSON_IsNumber(epoch_item)) {
        ESP_LOGE(TAG, "build_epoch missing or not a number in firmware.json");
        cJSON_Delete(root);
        return ESP_FAIL;
    }

    const cJSON *file_item = cJSON_GetObjectItem(root, "file");
    if (cJSON_IsString(file_item) && file_item->valuestring) {
        snprintf(out_info->file, sizeof(out_info->file), "%s", file_item->valuestring);
    }

    out_info->remote_build_epoch = (uint32_t)epoch_item->valuedouble;
    out_info->update_available = out_info->remote_build_epoch > out_info->local_build_epoch;
    cJSON_Delete(root);

    ESP_LOGI(TAG,
             "remote build_epoch=%" PRIu32 " local=%" PRIu32,
             out_info->remote_build_epoch,
             out_info->local_build_epoch);

    if (!out_info->update_available) {
        ESP_LOGI(TAG, "Firmware is up to date");
    }

    return ESP_OK;
}

esp_err_t fw_download_latest(const app_config_t *cfg, fw_download_result_t *result)
{
    fw_download_info_t info;

    if (result) {
        *result = FW_DOWNLOAD_NOT_NEEDED;
    }

    ESP_RETURN_ON_ERROR(fw_download_probe(cfg, &info), TAG, "firmware probe failed");

    if (!info.update_available) {
        return ESP_OK;
    }

    char fw_url[200];
    snprintf(fw_url, sizeof(fw_url), "%s/%s", cfg->fw_update.url, info.file);
    ESP_LOGI(TAG, "Downloading %s", fw_url);

    ESP_RETURN_ON_ERROR(download_firmware(fw_url), TAG, "firmware download failed");

    if (result) {
        *result = FW_DOWNLOAD_DONE;
    }
    return ESP_OK;
}
