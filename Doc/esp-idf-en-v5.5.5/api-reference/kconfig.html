## Firmware/Robo-Trickler-IDF/sdkconfig.defaults
```kconfig
CONFIG_IDF_TARGET="esp32"
CONFIG_ESPTOOLPY_FLASHSIZE_4MB=y
CONFIG_ESPTOOLPY_FLASHSIZE="4MB"
CONFIG_PARTITION_TABLE_CUSTOM=y
CONFIG_PARTITION_TABLE_CUSTOM_FILENAME="partitions.csv"
CONFIG_PARTITION_TABLE_FILENAME="partitions.csv"
CONFIG_PARTITION_TABLE_OFFSET=0x8000
CONFIG_LV_COLOR_DEPTH_16=y
CONFIG_LV_COLOR_DEPTH=16
# CONFIG_LV_COLOR_16_SWAP is not set
# CONFIG_LV_BUILD_EXAMPLES is not set
```

## Firmware/RoboTricklerUI-IDF/sdkconfig.defaults
```kconfig
CONFIG_IDF_TARGET="esp32"
CONFIG_ESPTOOLPY_FLASHSIZE_4MB=y
CONFIG_ESPTOOLPY_FLASHMODE_DIO=y
CONFIG_ESPTOOLPY_FLASHFREQ_80M=y
CONFIG_ESP_DEFAULT_CPU_FREQ_MHZ_240=y
CONFIG_PARTITION_TABLE_CUSTOM=y
CONFIG_PARTITION_TABLE_CUSTOM_FILENAME="partitions.csv"
CONFIG_ESP_MAIN_TASK_STACK_SIZE=8192
CONFIG_ESP_MAIN_TASK_AFFINITY_CPU1=y
CONFIG_FREERTOS_HZ=1000
CONFIG_LV_CONF_SKIP=y
CONFIG_LV_COLOR_DEPTH_16=y
CONFIG_LV_FONT_MONTSERRAT_14=y
CONFIG_LV_FONT_MONTSERRAT_32=y
CONFIG_LV_FONT_MONTSERRAT_48=y
CONFIG_LV_FONT_DEFAULT_MONTSERRAT_14=y
```

## Firmware/RoboTricklerUI-esp-idf/main/Kconfig.projbuild
```kconfig
menu "RoboTrickler"

    config ROBOTRICKLER_SCALE_TIMEOUT_MS
        int "Scale serial timeout (ms)"
        default 2000
        range 500 10000
        help
            How long to wait for a response from the scale before reporting
            a timeout. Increase if using a slow baud rate or long RS232 cable.

    config ROBOTRICKLER_DISP_STACK_SIZE
        int "LVGL display task stack size (bytes)"
        default 12288
        range 8192 32768
        help
            Stack size for the LVGL timer/render task (core 0).
            Increase if stack overflow is observed (check HWM in debug log).

    config ROBOTRICKLER_MAIN_STACK_SIZE
        int "Main loop task stack size (bytes)"
        default 12288
        range 8192 32768
        help
            Stack size for the main application loop task (core 1).
            Increase if stack overflow is observed (check HWM in debug log).

    config ROBOTRICKLER_HTTP_STACK_SIZE
        int "HTTP server task stack size (bytes)"
        default 12288
        range 8192 32768
        help
            Stack size for the ESP HTTP server task.
            Increase if stack overflow occurs during file upload/download.

endmenu
```

## Firmware/RoboTricklerUI-esp-idf/sdkconfig.defaults
```kconfig
# Flash / Partition
CONFIG_ESPTOOLPY_FLASHSIZE_8MB=y
CONFIG_PARTITION_TABLE_CUSTOM=y
CONFIG_PARTITION_TABLE_CUSTOM_FILENAME="partitions.csv"

# FreeRTOS
CONFIG_FREERTOS_HZ=1000
CONFIG_ESP_MAIN_TASK_STACK_SIZE=8192

# Task watchdog
# IDLE0: httpd legitimately blocks core 0 during SD card reads (SDSPI poll_busy
#        uses spi_device_polling_transmit with no yield).
# IDLE1: stepper_task (priority 4) legitimately holds core 1 during moves;
#        taskYIELD() never reaches IDLE1 (priority 0).
#        stepper_task subscribes to the TWDT directly and resets it each step,
#        so real hangs are still caught.
CONFIG_ESP_TASK_WDT_CHECK_IDLE_TASK_CPU0=n
CONFIG_ESP_TASK_WDT_CHECK_IDLE_TASK_CPU1=n

# FAT filesystem (SD card)
CONFIG_FATFS_LFN_HEAP=y
CONFIG_FATFS_MAX_LFN=255
CONFIG_FATFS_CODEPAGE_850=y

# HTTP server
CONFIG_HTTPD_MAX_URI_HANDLERS=20
CONFIG_HTTPD_MAX_REQ_HDR_LEN=1024
CONFIG_HTTPD_STACK_SIZE=8192

# mDNS
CONFIG_MDNS_TASK_PRIORITY=5

# SPI
CONFIG_SPI_MASTER_ISR_IN_IRAM=y
CONFIG_SPI_MASTER_IN_IRAM=y

# WiFi
CONFIG_ESP_WIFI_STATIC_RX_BUFFER_NUM=10
CONFIG_ESP_WIFI_DYNAMIC_RX_BUFFER_NUM=32

# Logging
CONFIG_LOG_DEFAULT_LEVEL_INFO=y

# LVGL — disable demos/examples to keep binary small
CONFIG_LV_BUILD_EXAMPLES=n
CONFIG_LV_USE_DEMO_WIDGETS=n
CONFIG_LV_USE_DEMO_BENCHMARK=n
CONFIG_LV_USE_DEMO_STRESS=n
CONFIG_LV_USE_DEMO_MUSIC=n

# HTTPS (needed for firmware check request to strenuous.dev)
CONFIG_ESP_TLS_USING_MBEDTLS=y
CONFIG_ESP_HTTP_CLIENT_ENABLE_HTTPS=y

# XPT2046
# Keep raw ADC readings so we can apply the same calibration math as the old TFT_eSPI firmware.
# CONFIG_XPT2046_CONVERT_ADC_TO_COORDS is not set
```
